#include "fdm.dtsi"



&default_kscan {
    col-gpios
        = <&gpio0 9 GPIO_ACTIVE_HIGH>
        , <&gpio0 10 GPIO_ACTIVE_HIGH>
        , <&gpio1 11 GPIO_ACTIVE_HIGH>
        , <&gpio1 13 GPIO_ACTIVE_HIGH>
        , <&gpio1 15 GPIO_ACTIVE_HIGH>
        , <&gpio0 20 GPIO_ACTIVE_HIGH>
        ;

    row-gpios
      = <&gpio0 6 (GPIO_ACTIVE_HIGH | GPIO_PULL_DOWN)>
      , <&gpio0 8 (GPIO_ACTIVE_HIGH | GPIO_PULL_DOWN)>
      , <&gpio0 17 (GPIO_ACTIVE_HIGH | GPIO_PULL_DOWN)>
      , <&gpio0 20 (GPIO_ACTIVE_HIGH | GPIO_PULL_DOWN)>
      , <&gpio0 22 (GPIO_ACTIVE_HIGH | GPIO_PULL_DOWN)>
      , <&gpio0 24 (GPIO_ACTIVE_HIGH | GPIO_PULL_DOWN)>
      ;

};
