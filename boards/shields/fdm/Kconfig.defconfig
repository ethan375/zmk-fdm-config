## boards/shields/fdm/Kconfig.defconfig
```kconfig
if SHIELD_FDM_LEFT

  config ZMK_KEYBOARD_NAME
    default "split kb"

  config ZMK_SPLIT_ROLE_CENTRAL
    default y

endif

if SHIELD_FDM_LEFT || SHIELD_FDM_RIGHT

  config ZMK_SPLIT 
    default y 

  config ZMK_SPLIT_BLE
    default y

endif

if SHIELF_FDM_RIGHT
  
  config ZMK_SPLIT_ROLE_CENTRAL
    default n 

  config ZMK_SPLIT_BLE_CENTRAL_BATTERY_LEVEL_FETCHING
    default y

endif
```

## boards/shields/fdm/fdm/kconfig.shield
```kconfig
config SHIELD_FDM_RIGHT
   def_bool $(shields_list_contains,fdm_right)

config SHIELD_FDM_LEFT
   def_bool $(shields_list_contains,fdm_left)
```

## boards/shields/fdm/kconfig.defconfig
```kconfig
if SHIELD_FDM_LEFT

config ZMK_FDM
    default "fdm"

config ZMK_SPLIT_ROLE_CENTRAL
  default y

endif

if SHIELD_FDM_LEFT || SHIELD_FDM_RIGHT

config ZMK_SPLIT 
  default y 

endif
```

## boards/shields/sla/Kconfig.defconfig
```kconfig
if SHIELD_FDM_LEFT

  config ZMK_KEYBOARD_NAME
    default "split kb"

  config ZMK_SPLIT_ROLE_CENTRAL
    default y

  config ZMK_SPLIT_BLE_CENTRAL_BATTERY_LEVEL_FETCHING
    default y

  config ZMK_SPLIT_BLE_CENTRAL_BATTERY_LEVEL_PROXY
    default y
  

endif

if SHIELD_FDM_LEFT || SHIELD_FDM_RIGHT

  config ZMK_SPLIT 
    default y 

  config ZMK_SPLIT_BLE
    default y

  config ZMK_IDLE_TIMEOUT
    default 300000

  config ZMK_IDLE_SLEEP_TIMEOUT
    default 600000

  config ZMK_SLEEP
    default y

  config ZMK_DISPLAY
    default y 


endif

if SHIELD_FDM_RIGHT
 
  config ZMK_SPLIT_ROLE_CENTRAL
    default n
 
endif
```
