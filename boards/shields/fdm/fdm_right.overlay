#include "fdm.dtsi"


&kscan0 {

    col-gipos
        = <&pro_micro 115 GPIO_ACTIVE_HIGH>
        , <&pro_micro 113 GPIO_ACTIVE_HIGH>
        , <&pro_micro 11 GPIO_ACTIVE_HIGH>
        , <&pro_micro 10 GPIO_ACTIVE_HIGH>
        , <&pro_micro 9 GPIO_ACTIVE_HIGH>
        ;
    



    row-gpios
      = <&pro_micro 22 (GPIO_ACTIVE_HIGH | GPIO_PULL_DOWN)>
      , <&pro_micro 24 (GPIO_ACTIVE_HIGH | GPIO_PULL_DOWN)>
      , <&pro_micro 100 (GPIO_ACTIVE_HIGH | GPIO_PULL_DOWN)>
      , <&pro_micro 11 (GPIO_ACTIVE_HIGH | GPIO_PULL_DOWN)>
      , <&pro_micro 104 (GPIO_ACTIVE_HIGH | GPIO_PULL_DOWN)>
      , <&pro_micro 106 (GPIO_ACTIVE_HIGH | GPIO_PULL_DOWN)>
      ;

};

&default_transform {
  col-offset = <6>;
};


