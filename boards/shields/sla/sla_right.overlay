#include "sla.dtsi"
#include <dt-bindings/pinctrl/nrf-pinctrl.h>

&default_kscan {

    col-gpios
        = <&gpio1 15 GPIO_ACTIVE_HIGH>
        , <&gpio1 13 GPIO_ACTIVE_HIGH>
        , <&gpio1 11 GPIO_ACTIVE_HIGH>
        , <&gpio0 10 GPIO_ACTIVE_HIGH>
        , <&gpio0 9 GPIO_ACTIVE_HIGH>
        ;



    row-gpios
      = <&gpio0 22 (GPIO_ACTIVE_HIGH | GPIO_PULL_DOWN)>
      , <&gpio0 24 (GPIO_ACTIVE_HIGH | GPIO_PULL_DOWN)>
      , <&gpio1 00 (GPIO_ACTIVE_HIGH | GPIO_PULL_DOWN)>
      , <&gpio0 11 (GPIO_ACTIVE_HIGH | GPIO_PULL_DOWN)>
      , <&gpio1 4 (GPIO_ACTIVE_HIGH | GPIO_PULL_DOWN)>
      , <&gpio1 6 (GPIO_ACTIVE_HIGH | GPIO_PULL_DOWN)>
      , <&gpio0 20 (GPIO_ACTIVE_HIGH | GPIO_PULL_DOWN)>
      ;

};


//&pinctrl {
//  spi0_default: spi0_default {
//    nice_view {
//      psels = <NRF_PSEL(SPIM_SCK, 1, 00)>,
//      psels = <NRF_PSEL(SPIM_MOSI, 1, 04)>,
//      psels = <NRF_PSEL(SPIM_CS, 1, 06)>;
//    };
//  };
//}

&default_transform {
  col-offset = <6>;
};


